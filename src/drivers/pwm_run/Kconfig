## src/drivers/pwm_run/Kconfig
```kconfig
menuconfig DRIVERS_PWM_RUN
	bool "pwm_run"
	default n
	---help---
		pwm output in channel n
```

## src/examples/hello_pro/Kconfig
```kconfig
menuconfig EXAMPLES_HELLO_PRO
	bool "hello_pro"
	default n
	---help---
		Enable support for hello_pro
```

## src/examples/pwm_run/Kconfig
```kconfig
menuconfig EXAMPLES_PWM_RUN
	bool "pwm_run"
	default n
	---help---
		pwm output in channel n
```

## src/examples/serial_hello/Kconfig
```kconfig
menuconfig EXAMPLES_SERIAL_HELLO
	bool "serial_hello"
	default n
	---help---
		Display Hello in serial
```
